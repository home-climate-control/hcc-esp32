## main/Kconfig.projbuild
```kconfig
menu "hcc-esp32 Configuration"

    menu "General"

        config HCC_ESP32_FLASH_LED
            depends on HCC_ESP32_ONE_WIRE_ENABLE
            bool "Flash the LED on important actions"
            default true
            help

                If enabled, the onboard LED will stay on while establishing
                WiFi connectivity and connecting to the MQTT broker, and
                also for the period specified in 1-Wire menu before and
                after 1-Wire poll. This will not play nicely with other
                entities that may want to control the LED, so disable if it
                causes unwanted interference, or if you're running out of
                GPIO pins.

        config HCC_ESP32_FLASH_LED_GPIO
            depends on HCC_ESP32_FLASH_LED
            int "LED GPIO number"
            range 0 33
            default 13
            help
                GPIO number (IOxx) for the LED to blink.
                Some GPIOs are used for other purposes (flash connections, etc.) and cannot be used.
                GPIOs 34-39 are input-only so cannot be used to control A4988.
    endmenu

    menu "Connectivity"
        choice EXAMPLE_CONNECT_INTERFACE
            prompt "Connect using"
            default EXAMPLE_CONNECT_WIFI
            help
                Protocol examples can use Wi-Fi or Ethernet to connect to the network.
                Choose which interface to use.

            config EXAMPLE_CONNECT_WIFI
                bool "Wi-Fi"

            config EXAMPLE_CONNECT_ETHERNET
                bool "Ethernet"

        endchoice

        if EXAMPLE_CONNECT_WIFI
            config EXAMPLE_WIFI_SSID
                string "WiFi SSID"
                default "myssid"
                help
                    SSID (network name) for the example to connect to.

            config EXAMPLE_WIFI_PASSWORD
                string "WiFi Password"
                default "mypassword"
                help
                    WiFi password (WPA or WPA2) for the example to use.
                    Can be left blank if the network has no security set.
        endif

        if EXAMPLE_CONNECT_ETHERNET
            choice EXAMPLE_USE_ETHERNET
                prompt "Ethernet Type"
                default EXAMPLE_USE_INTERNAL_ETHERNET if IDF_TARGET_ESP32
                default EXAMPLE_USE_DM9051 if !IDF_TARGET_ESP32
                help
                    Select which kind of Ethernet will be used in the example.

                config EXAMPLE_USE_INTERNAL_ETHERNET
                    depends on IDF_TARGET_ESP32
                    select ETH_USE_ESP32_EMAC
                    bool "Internal EMAC"
                    help
                        Select internal Ethernet MAC controller.

                config EXAMPLE_USE_DM9051
                    bool "DM9051 Module"
                    select ETH_USE_SPI_ETHERNET
                    select ETH_SPI_ETHERNET_DM9051
                    help
                        Select external SPI-Ethernet module.

                config EXAMPLE_USE_OPENETH
                    bool "OpenCores Ethernet MAC (EXPERIMENTAL)"
                    select ETH_USE_OPENETH
                    help
                        When this option is enabled, the example is built with support for
                        OpenCores Ethernet MAC, which allows testing the example in QEMU.
                        Note that this option is used for internal testing purposes, and
                        not officially supported. Examples built with this option enabled
                        will not run on a real ESP32 chip.

            endchoice

            if EXAMPLE_USE_INTERNAL_ETHERNET
                choice EXAMPLE_ETH_PHY_MODEL
                    prompt "Ethernet PHY Device"
                    default EXAMPLE_ETH_PHY_IP101
                    help
                        Select the Ethernet PHY device to use in the example.

                    config EXAMPLE_ETH_PHY_IP101
                        bool "IP101"
                        help
                            IP101 is a single port 10/100 MII/RMII/TP/Fiber Fast Ethernet Transceiver.
                            Goto http://www.icplus.com.tw/pp-IP101G.html for more information about it.

                    config EXAMPLE_ETH_PHY_RTL8201
                        bool "RTL8201/SR8201"
                        help
                            RTL8201F/SR8201F is a single port 10/100Mb Ethernet Transceiver with auto MDIX.
                            Goto http://www.corechip-sz.com/productsview.asp?id=22 for more information about it.

                    config EXAMPLE_ETH_PHY_LAN8720
                        bool "LAN8720"
                        help
                            LAN8720A is a small footprint RMII 10/100 Ethernet Transceiver with HP Auto-MDIX Support.
                            Goto https://www.microchip.com/LAN8720A for more information about it.

                    config EXAMPLE_ETH_PHY_DP83848
                        bool "DP83848"
                        help
                            DP83848 is a single port 10/100Mb/s Ethernet Physical Layer Transceiver.
                            Goto http://www.ti.com/product/DP83848J for more information about it.
                endchoice

                config EXAMPLE_ETH_MDC_GPIO
                    int "SMI MDC GPIO number"
                    default 23
                    help
                        Set the GPIO number used by SMI MDC.

                config EXAMPLE_ETH_MDIO_GPIO
                    int "SMI MDIO GPIO number"
                    default 18
                    help
                        Set the GPIO number used by SMI MDIO.
            endif

            if EXAMPLE_USE_DM9051
                config EXAMPLE_DM9051_SPI_HOST
                    int "SPI Host Number"
                    range 0 2
                    default 1
                    help
                        Set the SPI host used to communicate with DM9051.

                config EXAMPLE_DM9051_SCLK_GPIO
                    int "SPI SCLK GPIO number"
                    range 0 33
                    default 19
                    help
                        Set the GPIO number used by SPI SCLK.

                config EXAMPLE_DM9051_MOSI_GPIO
                    int "SPI MOSI GPIO number"
                    range 0 33
                    default 23
                    help
                        Set the GPIO number used by SPI MOSI.

                config EXAMPLE_DM9051_MISO_GPIO
                    int "SPI MISO GPIO number"
                    range 0 33
                    default 25
                    help
                        Set the GPIO number used by SPI MISO.

                config EXAMPLE_DM9051_CS_GPIO
                    int "SPI CS GPIO number"
                    range 0 33
                    default 22
                    help
                        Set the GPIO number used by SPI CS.

                config EXAMPLE_DM9051_SPI_CLOCK_MHZ
                    int "SPI clock speed (MHz)"
                    range 20 80
                    default 20
                    help
                        Set the clock speed (MHz) of SPI interface.

                config EXAMPLE_DM9051_INT_GPIO
                    int "Interrupt GPIO number"
                    default 4
                    help
                        Set the GPIO number used by DM9051 interrupt.
            endif

            config EXAMPLE_ETH_PHY_RST_GPIO
                int "PHY Reset GPIO number"
                default 5
                help
                    Set the GPIO number used to reset PHY chip.
                    Set to -1 to disable PHY chip hardware reset.

            config EXAMPLE_ETH_PHY_ADDR
                int "PHY Address"
                range 0 31 if EXAMPLE_USE_INTERNAL_ETHERNET
                range 1 1 if !EXAMPLE_USE_INTERNAL_ETHERNET
                default 1
                help
                    Set PHY address according your board schematic.
        endif

        config EXAMPLE_CONNECT_IPV6
            bool "Obtain IPv6 link-local address"
            depends on IDF_TARGET_ESP32
            # ToDo: remove once IPV6 is supported on esp32s2
            default y
            help
                By default, examples will wait until IPv4 and IPv6 addresses are obtained.
                Disable this option if the network does not support IPv6.
    endmenu

    menu "MQTT"

        config BROKER_URL
            string "MQTT broker URL"
            help
                URL of the MQTT broker to connect to

        config BROKER_PUB_ROOT
            string "Publish topic root"
            default "/hcc"
            help
                MQTT topic to publish messages under ($topic/edge for device messages, $topic/sensor for sensor samples)

        config BROKER_SUB_ROOT
            string "Subscribe topic root"
            default "/edge"
            help
                MQTT topic root to listen to commands on
    endmenu

    menu "1-Wire"

        config HCC_ESP32_ONE_WIRE_ENABLE
            bool "Enable 1-Wire device support"
            default y

        config ONE_WIRE_GPIO
            depends on HCC_ESP32_ONE_WIRE_ENABLE
            int "1-Wire GPIO number"
            range 0 33
            default 4
            help
                GPIO number (IOxx) to access One Wire Bus.
                Some GPIOs are used for other purposes (flash connections, etc.) and cannot be used.
                GPIOs 34-39 are input-only so cannot be used to drive the One Wire Bus.

        config HCC_ESP32_ONE_WIRE_MAX_DEVICES
            depends on HCC_ESP32_ONE_WIRE_ENABLE
            int "Max number of 1-Wire devices to recognize"
            range 4 16
            default 8
            help
                Max number of 1-Wire devices to find and poll.
                VT: FIXME: This should really be a dynamic.
                (https://github.com/home-climate-control/hcc-esp32/issues/15)

        config ONE_WIRE_POLL_SECONDS
            depends on HCC_ESP32_ONE_WIRE_ENABLE
            int "1-Wire bus poll interval"
            range 1 300
            default 10
            help
                How often 1-Wire sensors need to be polled. 30 seconds is enough
                for HVAC applications.

        config HCC_ESP32_FLASH_LED_MILLIS
            depends on HCC_ESP32_FLASH_LED
            int "Milliseconds to keep the LED on around 1-Wire poll"
            range 1 100
            default 10
            help
                The LED will stay on for this many milliseconds before and
                after 1-Wire bus poll. 1ms will be barely noticeable if you
                look at it, 100 ms will be obnoxious, 10 to 20 probably
                right.

    endmenu

    menu "A4988 Stepper Driver"

        config HCC_ESP32_A4988_ENABLE
            bool "Enable A4988 stepper driver"
            default n

        config HCC_ESP32_A4988_PIN_DIR
            depends on HCC_ESP32_A4988_ENABLE
            int "DIR GPIO number"
            range 0 33
            default 26
            help
                GPIO number (IOxx) to connect to A4988 pin 8 (DIR).
                Some GPIOs are used for other purposes (flash connections, etc.) and cannot be used.
                GPIOs 34-39 are input-only so cannot be used to control A4988.

        config HCC_ESP32_A4988_PIN_STEP
            depends on HCC_ESP32_A4988_ENABLE
            int "STEP GPIO number"
            range 0 33
            default 25
            help
                GPIO number (IOxx) to connect to A4988 pin 7 (STEP).
                Some GPIOs are used for other purposes (flash connections, etc.) and cannot be used.
                GPIOs 34-39 are input-only so cannot be used to control A4988.

        config HCC_ESP32_A4988_MICROSTEPPING
            depends on HCC_ESP32_A4988_ENABLE
            bool "Enable microstepping"
            default y
            help
                When this switch is enabled, three additional GPIOs are required, but it becomes possible to use microstepping.
                Leaving MSx pins disconnected will make the driver operate in full step mode.
                Some GPIOs are used for other purposes (flash connections, etc.) and cannot be used.
                GPIOs 34-39 are input-only so cannot be used to control A4988.

        config HCC_ESP32_A4988_PIN_MS1
            depends on HCC_ESP32_A4988_MICROSTEPPING
            int "MS1 GPIO number"
            range 0 33
            default 14
            help
                GPIO number (IOxx) to connect to A4988 pin 2 (MS1).
                Some GPIOs are used for other purposes (flash connections, etc.) and cannot be used.
                GPIOs 34-39 are input-only so cannot be used to control A4988.

        config HCC_ESP32_A4988_PIN_MS2
            depends on HCC_ESP32_A4988_MICROSTEPPING
            int "MS2 GPIO number"
            range 0 33
            default 32
            help
                GPIO number (IOxx) to connect to A4988 pin 3 (MS2).
                Some GPIOs are used for other purposes (flash connections, etc.) and cannot be used.
                GPIOs 34-39 are input-only so cannot be used to control A4988.

        config HCC_ESP32_A4988_PIN_MS3
            depends on HCC_ESP32_A4988_MICROSTEPPING
            int "MS3 GPIO number"
            range 0 33
            default 15
            help
                GPIO number (IOxx) to connect to A4988 pin 4 (MS3).
                Some GPIOs are used for other purposes (flash connections, etc.) and cannot be used.
                GPIOs 34-39 are input-only so cannot be used to control A4988.

        config HCC_ESP32_A4988_POWERSAVE
            depends on HCC_ESP32_A4988_ENABLE
            bool "Enable power saving features"
            default n
            help
                When this switch is enabled, one additional GPIOs is required, but it becomes possible to use power saving features.

        config HCC_ESP32_A4988_PIN_SLP
            depends on HCC_ESP32_A4988_POWERSAVE
            int "SLP GPIO number"
            range 0 33
            default 33
            help
                GPIO number (IOxx) to connect to A4988 pin 6 (SLP).
                Note that usually RST and SLP pins are connected together, so you will have to figure out how to pull RST high.
                Some GPIOs are used for other purposes (flash connections, etc.) and cannot be used.
                GPIOs 34-39 are input-only so cannot be used to control A4988.

        config HCC_ESP32_A4988_LIMIT_SWITCH_ENABLE
            depends on HCC_ESP32_A4988_ENABLE
            bool "Enable limit switch"
            default n
            help
                When this switch is enabled, one additional GPIOs is required, but it becomes possible to use a limit switch.

        config HCC_ESP32_A4988_PIN_LIMIT
            depends on HCC_ESP32_A4988_LIMIT_SWITCH_ENABLE
            int "Limit switch GPIO number"
            range 13 39
            default 34
            help
                GPIO number (IOxx) to connect the limit switch to.
                Some GPIOs are used for other purposes (flash connections, etc.) and cannot be used.
                OGPIOs 34-39 are input-only so cannot be used to control A4988.

        choice HCC_ESP32_A4988_LIMIT_DIRECTION
            depends on HCC_ESP32_A4988_LIMIT_SWITCH_ENABLE
            bool "Direction to the limit switch"
            help
                Choose which direction the stepper travels to the limit switch.

        config HCC_ESP32_A4988_LIMIT_UP
            bool "Up"
            help
                Stepper goes up to hit the limit switch.

        config HCC_ESP32_A4988_LIMIT_DOWN
            bool "Down"
            help
                Stepper goes down to hit the limit switch.
        endchoice

        config HCC_ESP32_A4988_LIMIT_DIRECTION
            int
            default 1 if HCC_ESP32_A4988_LIMIT_UP
            default -1 if HCC_ESP32_A4988_LIMIT_DOWN

        config HCC_ESP32_A4988_FAILSAFE_ENABLE
            depends on HCC_ESP32_A4988_LIMIT_SWITCH_ENABLE
            bool "Enable failsafe position"
            default n
            help
                When this switch is enabled, the stepper will travel to the limit switch on boot,
                then back to the specified position.

        config HCC_ESP32_A4988_FAILSAFE_POSITION
            depends on HCC_ESP32_A4988_FAILSAFE_ENABLE
            int "Failsafe position"
            help
                The stepper will travel to the limit switch on boot, then come back to this position.
    endmenu

endmenu
```
